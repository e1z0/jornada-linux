## kernels/linux-3.16.81/arch/arm/mm/Kconfig.rej
```kconfig
--- arch/arm/mm/Kconfig
+++ arch/arm/mm/Kconfig
@@ -429,6 +429,7 @@ config CPU_32v4
 	select NEED_KUSER_HELPERS
 	select TLS_REG_EMUL if SMP || !MMU
 	select CPU_NO_EFFICIENT_FFS
+	select ARMv4_BX_EMUL if !SMP
 
 config CPU_32v4T
 	bool
```

## kernels/linux-3.16.81/sound/arm/Kconfig
```kconfig
# ALSA ARM drivers

menuconfig SND_ARM
	bool "ARM sound devices"
	depends on ARM
	default y
	help
	  Support for sound devices specific to ARM architectures.
	  Drivers that are implemented on ASoC can be found in
	  "ALSA for SoC audio support" section.

config SND_PXA2XX_LIB
	tristate
	select SND_AC97_CODEC if SND_PXA2XX_LIB_AC97
	select SND_DMAENGINE_PCM

config SND_PXA2XX_LIB_AC97
	bool

if SND_ARM

config SND_ARMAACI
	tristate "ARM PrimeCell PL041 AC Link support"
	depends on ARM_AMBA
	select SND_PCM
	select SND_AC97_CODEC

config SND_PXA2XX_PCM
	tristate
	select SND_PCM

config SND_PXA2XX_AC97
	tristate "AC97 driver for the Intel PXA2xx chip"
	depends on ARCH_PXA
	select SND_PXA2XX_PCM
	select SND_AC97_CODEC
	select SND_PXA2XX_LIB
	select SND_PXA2XX_LIB_AC97
	help
	  Say Y or M if you want to support any AC97 codec attached to
	  the PXA2xx AC97 interface.

config SND_JORNADA720
        tristate "Jornada 720 Sound Driver"
        depends on ARM && ARCH_SA1100 && SA1111 && SND
        select SND_PCM
        help
          Say Y here if you have a Jornada 720 HPC
          and want to use its Philips UDA 1341 audio chip.
          To compile this driver as a module, choose M here: the module
          will be called snd-jornada720.

endif	# SND_ARM
```
